## practice/lwip-ch12-tcp-reliability/main/Kconfig.projbuild
```kconfig
menu "lwIP ch12 lab"

config CH12_SWEEP_ONLY
    bool "Run only the window-sweep transfer (experiment c)"
    default n
    help
        Skip the loss-injection and Nagle phases and run a single
        bulk transfer against port 8012 with fixed random frame drops,
        for the SND_BUF/WND sweep builds.

config CH12_SWEEP_LOSS_PCT
    int "Frame drop percentage during the window-sweep transfer"
    range 0 90
    default 3

endmenu
```

## practice/lwip-ch15-raw-api-callbacks/sdkconfig.defaults.thrcheck
```kconfig
# lwIP 深度解析（十五）跨线程误用断言变体：
# 打开 CONFIG_LWIP_CHECK_THREAD_SAFETY 后，所有 LWIP_ASSERT_CORE_LOCKED()
# 的调用点（tcp_new/tcp_write/tcp_poll...）都会在非 tcpip 上下文触发断言复位。
# 构建方法：idf.py -D SDKCONFIG_DEFAULTS="sdkconfig.defaults;sdkconfig.defaults.thrcheck" build

CONFIG_ETH_USE_OPENETH=y
CONFIG_LWIP_STATS=y
CONFIG_LWIP_MAX_SOCKETS=16
CONFIG_LWIP_CHECK_THREAD_SAFETY=y
```

## practice/lwip-ch18-esp32-wifi-lwip-integration/sdkconfig.defaults
```kconfig
# ch18 实验工程配置
# openeth：QEMU 里的 OpenCores 网卡驱动（ch3 模板同款）
CONFIG_ETH_USE_OPENETH=y
```

## practice/lwip-ch20-http-server/sdkconfig.defaults
```kconfig
# ch20：HTTP server 实验
# openeth 网卡（QEMU 专用，见 ch3 模板）
CONFIG_ETH_USE_OPENETH=y

# 压日志噪声到 WARN：压测热路径零输出；
# 但 httpd 的 408/431/accept 失败等告警（ESP_LOGW）保留——它们正是故障注入实验的证据
CONFIG_LOG_DEFAULT_LEVEL_WARN=y
```

## practice/lwip-ch22-tls-esp-tls-mbedtls/sdkconfig.defaults
```kconfig
# ch22 TLS 实验：QEMU 无硬件加密外设仿真，用纯软件密码实现（确定性口径）
CONFIG_ETH_USE_OPENETH=y
CONFIG_MBEDTLS_HARDWARE_AES=n
CONFIG_MBEDTLS_HARDWARE_SHA=n
CONFIG_MBEDTLS_HARDWARE_MPI=n

# 握手全记录：打开 mbedTLS 调试日志（esp-tls 内部自动调 mbedtls_esp_enable_debug_log）
CONFIG_MBEDTLS_DEBUG=y
# choice 默认即 VERBOSE(4)
CONFIG_MBEDTLS_DEBUG_LEVEL_VERBOSE=y

# 日志级别开到 Debug，mbedTLS 逐行握手日志才能透出
CONFIG_LOG_DEFAULT_LEVEL_DEBUG=y

# 故障注入/教学姿势：允许默认跳过服务器证书验证（仅在实验工程开启！）
CONFIG_ESP_TLS_INSECURE=y
CONFIG_ESP_TLS_SKIP_SERVER_CERT_VERIFY=y

# 内存观察与任务清单
CONFIG_FREERTOS_USE_TRACE_FACILITY=y
```
