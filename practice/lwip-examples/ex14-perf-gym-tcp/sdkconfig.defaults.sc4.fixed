## practice/lwip-examples/ex15-perf-gym-rtos/sdkconfig.defaults.sc0
```kconfig
# 场景变体：sc0 = 健康基线（无故障注入，纯观测对照轮）
# 构建方式：SDKCONFIG_DEFAULTS="sdkconfig.defaults;sdkconfig.defaults.sc0" idf.py build -B build-sc0
CONFIG_GYM_SCENARIO=0
```

## practice/lwip-examples/ex15-perf-gym-rtos/sdkconfig.defaults.sc1
```kconfig
# 场景变体：sc1 = 优先级倒挂饿死监控（ch19 占空比实验的应用版）
# 构建方式：SDKCONFIG_DEFAULTS="sdkconfig.defaults;sdkconfig.defaults.sc1" idf.py build -B build-sc1
CONFIG_GYM_SCENARIO=1
```

## practice/lwip-examples/ex15-perf-gym-rtos/sdkconfig.defaults.sc3
```kconfig
# 场景变体：sc3 = tcpip 邮箱打满传导（ch13 实验 D 的应用版）
# 构建方式：SDKCONFIG_DEFAULTS="sdkconfig.defaults;sdkconfig.defaults.sc3" idf.py build -B build-sc3
CONFIG_GYM_SCENARIO=3
# 心跳探针提到 19（压过 tcpip=18）：本场景考察纯邮箱水位，按 Batch 4/7
# "测量探针优先级要压过 tcpip"的纪律隔离调度维度的连带伤害——否则饱和的
# tcpip 线程满负荷运转时，低于它的心跳会被连带饿出 kind=sched 假警报，
# 故事就串台到场景 1 了。
CONFIG_EX15_HB_PRIO=19
```

## practice/lwip-examples/ex15-perf-gym-rtos/sdkconfig.defaults.sc4
```kconfig
# 场景变体：sc4 = 任务栈余量耗尽告警（HWM 高水位教学，不含真溢出）
# 构建方式：SDKCONFIG_DEFAULTS="sdkconfig.defaults;sdkconfig.defaults.sc4" idf.py build -B build-sc4
CONFIG_GYM_SCENARIO=4
```

## practice/lwip-examples/ex16-zero-copy-cases/main/Kconfig.projbuild
```kconfig
menu "EX16 zero-copy-cases Configuration"

    config ZC_CASE
        int "Zero-copy case (0=catalog 1=rx-parse 2=tx-segment 3=layer-tax 4=stream-checksum 5=honest-boundary)"
        range 0 5
        default 0
        help
            0 说明模式（打印五案例目录 + 8330 入向命令口）；
            1 案例 A RX 就地解析：recv 回调直接在 pbuf payload 上解析协议头 vs 先 memcpy 再解析；
            2 案例 B TX 分段提交：头/体分离 write+MORE vs 用户侧拼大缓冲整体 write；
            3 案例 C 接收路径层级拷贝差：同一回声负载走 raw/netconn/socket 三层；
            4 案例 D 流式校验零落地：边收边算 Fletcher32 vs 收完落地整包再算；
            5 案例 E 诚实边界：IDF 硬编码 LWIP_NETIF_TX_SINGLE_PBUF=1 使 COPY 强制，
              apiflags 证据 + 行为学验证（write 后改源缓冲，收端 digest 定案）。

    # ---------------- 负载目的地 ----------------

    config ZC_HOST_REFLECTOR
        bool "Drive benchmarks against host reflector 10.0.2.2:8331 instead of loopback"
        default n
        help
            n（默认）：全部负载走 guest 内 127.0.0.1 自环，零外部依赖。
            y：负载出连宿主反射器 tools/reflector.py 监听的 10.0.2.2:8331（回显模式）。
            严禁把目的地址设为自身网卡 IP（10.0.2.15）——Batch 8 实测持续 TCP 吞吐会咬死
            tcpip 线程（gdb 卡在 pbuf_free / g_lwip_protect_mutex）。

    config ZC_HOST_PORT
        int "Host reflector port (used only when ZC_HOST_REFLECTOR=y)"
        range 1024 65535
        default 8331

    # ---------------- 案例参数 ----------------

    config ZC_ROUNDS_PER_STAGE
        int "Rounds measured per stage (each case runs copy/zc stages interleaved)"
        range 100 20000
        default 1200

    config ZC_BLOCK
        int "Interleave block size (alternate variant every N rounds)"
        range 25 5000
        default 300
        help
            同开机配对纪律的实现方式：copy 版与 zc 版按块交错而非先后整段，
            把"机器缓慢漂移"摊到两种变体上。

    config ZC_REC_BODY
        int "Case A record body size (bytes); record = 18B header + body"
        range 32 1400
        default 512

    config ZC_B_HDR
        int "Case B message header size (bytes)"
        range 8 128
        default 16

    config ZC_B_BODY
        int "Case B message body size (bytes)"
        range 64 4096
        default 1024

    config ZC_C_MSG
        int "Case C echo payload size (bytes)"
        range 8 1400
        default 256

    config ZC_C_MSGS
        int "Case C ping-pong messages per pass per layer"
        range 50 5000
        default 400

    config ZC_C_PASSES
        int "Case C interleave passes (raw->netconn->socket repeated)"
        range 1 20
        default 5

    config ZC_D_ARENA_BYTES
        int "Case D landing arena size (bytes, static buffer)"
        range 16384 196608
        default 114688

endmenu
```

## practice/lwip-pcapx-lab/main/Kconfig.projbuild
```kconfig
menu "pcapx lab experiments"

    config LAB_PCAPX_EXP_DROP
        bool "DROP experiment: ring=2048, snaplen=64, N=500 UDP, no pacing"
        default n
        help
            Replaces the default capture session with a ring-overflow run:
            500 back-to-back UDP frames into a 2048-byte ring with snaplen=64
            must produce the contract log line "W pcapx: DROP cnt=N" and the
            packet accounting identity rx+tx == filtered+dropped+written
            (after the writer has drained the ring).

    config LAB_PCAPX_EXP_CHURN
        bool "CHURN experiment: attach/detach x100 under UDP traffic"
        default n
        help
            Runs a UDP traffic generator task and cycles pcapx attach/detach
            100 times while it is running. Success criteria: no crash, no
            heap leak (heap_caps_get_free_size before/after within noise).

endmenu
```

## practice/onvif-labs/components/onvif/Kconfig
```kconfig
menu "ONVIF"

    config ONVIF_PROFILE_G
        bool "Enable Profile G (Recording/Replay skeleton, storage-less honest semantics)"
        default n
        help
            Recording/Replay 服务骨架（trc GetServiceCapabilities/GetRecordings/
            GetRecordingSummary + trt SetSynchronizationPoint）。本设备无持久存储：
            能力报 0 recordings、动态录制关闭——不做"伪装录制"。编译期裁剪：
            未开启的站不含任何 G 代码（gc-sections）；运行期另有 cfg.profile_g
            双保险（onvif_svc_config_t）。

endmenu
```

## practice/pcapx/Kconfig
```kconfig
menu "pcapx"

    config PCAPX_WRITER_PRIO
        int "pcapx writer task priority"
        range 1 24
        default 17
        help
            Priority of the "pcapx" writer task that drains the SPSC ring
            and writes pcap records to the configured sink (sink->write may
            block). Default 17 sits between the openeth emac_rx task (15)
            and tcpip_thread (18): fast enough to keep the ring drained
            under load, never preempting the stack itself.

    config PCAPX_WRITER_STACK
        int "pcapx writer task stack size (bytes)"
        range 2048 32768
        default 4096
        help
            Stack for the writer task. It runs sink->write() implementations
            (semihosting calls, UART drivers, esp_console exports), so keep
            headroom for the sink's stack usage.

    config PCAPX_RING_BYTES
        int "pcapx capture ring size (bytes)"
        range 1024 65536
        default 8192
        help
            Default SPSC ring capacity in bytes, used when
            pcapx_config_t.ring_bytes == 0. Each captured frame occupies
            12 bytes of metadata (8B timestamp + 2B orig_len + 2B caplen)
            plus min(frame_len, snaplen) bytes. A full ring drops NEW
            frames (keeps order, counts them in pcapx_stats_t.dropped).

    config PCAPX_SEMIHOST_SIMCALL_FALLBACK
        bool "Semihost sink: fall back to raw SIMCALL syscalls under QEMU"
        default y
        help
            ESP-IDF's esp_vfs_semihost driver requires an OpenOCD-style
            debugger attach (esp_cpu_dbgr_is_attached reads DSRSET bit0).
            Espressif QEMU's -semihosting does NOT set that bit: it traps
            the SIMCALL instruction with Xtensa ISS syscall numbers instead
            (write=4/open=5/close=6, qemu target/xtensa/xtensa-semi.c),
            which the IDF driver never uses. With this option enabled the
            semihost sink first tries the IDF VFS path (real hardware with
            OpenOCD attached) and, if registration returns
            ESP_ERR_NOT_SUPPORTED, falls back to raw SIMCALL syscalls that
            write straight to a host file relative to the QEMU process CWD.
            WARNING: SIMCALL is an ISS-only instruction; on a real ESP32
            (LX6) without OpenOCD attached executing it raises an illegal
            instruction. Real hardware must attach OpenOCD (VFS path) or
            use the UART/RAM sink. Xtensa only - RISC-V builds compile
            the fallback out.

endmenu
```
